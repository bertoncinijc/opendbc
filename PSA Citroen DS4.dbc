VERSION ""

NS_ :

BS_:

BU_: XXX

BO_ 552 NEW_MSG_1: 8 XXX
 SG_ NEW_SIGNAL_1 : 39|16@0+ (1,0) [0|65535] "" XXX

BO_ 841 NEW_MSG_2: 8 XXX
 SG_ NEW_SIGNAL_1 : 15|8@0+ (1,0) [0|255] "" XXX

BO_ 969 Steering: 8 XXX
 SG_ S : NaN|NaN@0+ (NaN,NaN) [NaN|2] "4" ,

BO_ 773 throttle: 8 XXX
 SG_ NEW_SIGNAL_1 : 0|8@1+ (1,0) [0|255] "" XXX
